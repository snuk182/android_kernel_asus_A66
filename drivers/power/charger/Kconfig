## drivers/power/charger/Kconfig
```kconfig
config MAXIM_8934_CHARGER
        bool "Support for Maxim 8934 charger"
        default y 

config DUMMY_CHARGER
        bool "Support for dummy charger"
        default y

config PM_8921_CHARGER
        bool "Support for PM 8921 charger"
        default y
```

## drivers/sensors/Kconfig
```kconfig
config SENSORS
	bool "Sensors Class Support"
	help
	  This option enables the sensor sysfs class in /sys/class/sensors.
	  You'll need this to do anything useful with sensorss. If unsure, say N.

config SENSORS_CM3623
	bool "PS ALS CM3623 support"
	default n
	---help---
	  ASUS SENSORS folder
```
